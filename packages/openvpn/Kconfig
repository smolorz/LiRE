## packages/openvpn/Kconfig
```kconfig
config LIRE_OPENVPN_INST
    bool "  Install OpenVPN"
    default y
    select LIRE_OPENSSL_INST
    help
    ...text...
```

## packages/orocos_bfl/Kconfig
```kconfig
config LIRE_OROCOS_BFL_INST
    bool "  Install orocos-bfl"
    default n 
    select LIRE_BOOST_INST
    help
    ...text...
```

## packages/parted/Kconfig
```kconfig
config LIRE_PARTED_INST
    bool "  Install parted"
    default y
    help
    Installs partitioning utilities.
```

## packages/pciutils/Kconfig
```kconfig
config LIRE_PCIUTILS_INST
    bool "  Install pciutils"
    default y
    help
    Installs the famous pciutils for probing pci devices (lspci).
```

## packages/pcl/Kconfig
```kconfig
config LIRE_PCL_INST
    bool "  Install pointclouds"
    default n
    select LIRE_FLANN_INST
    select LIRE_BOOST_INST
    select LIRE_EIGEN_INST
    help
    ...text...
```

## packages/policy/Kconfig
```kconfig
config LIRE_POLICY_INST
    bool "  Install Policy"
    depends on LIRE_SELINUX_ENABLE
    default y
    help
    ...text...
```

## packages/policycoreutils/Kconfig
```kconfig
config LIRE_POLICYCOREUTILS_INST
    bool "  Install PolicyCoreUtils"
    depends on LIRE_SELINUX_ENABLE
    default y
    select LIRE_LIBSELINUX_INST
    help
    ...text...
```

## packages/primesense/Kconfig
```kconfig
config LIRE_PRIMESENSE_INST
    bool "  Install PrimeSense camera driver lib"
    default y
    select LIRE_OPENNI_INST
    help
    ...text...
```

## packages/python/Kconfig
```kconfig
config LIRE_PYTHON_INST
    bool "  Install python"
    default n 
    select LIRE_NCURSES_INST
    select LIRE_ZLIB_INST
    select LIRE_BZIP2_INST
    help
    ...text...
```

## packages/pyyaml/Kconfig
```kconfig
config LIRE_PYYAML_INST
    bool "  Install PyYAML on target"
    default n 
    depends on LIRE_PYTHON_INST
    help
    ...text...
```

## packages/rack/Kconfig
```kconfig
config LIRE_RACK_INST
    bool "  Install Robotic Application Construction Kit (RACK)"
    default y
    select LIRE_XENOMAI_INST
    help

menu "  Dependencies"

depends on LIRE_RACK_INST

config LIRE_RACK_RTNET_SUPPORT
    bool "Enable RTnet support"
    default y
    select LIRE_RTNET_INST
    help

config LIRE_RACK_LIBRAW1394_SUPPORT
    bool "Enable libraw1394 support"
    default y
    select LIRE_LIBRAW1394_INST
    help

config LIRE_RACK_LIBDC1394_SUPPORT
    bool "Enable libdc1394 support"
    default y
    select LIRE_RACK_LIBRAW1394_SUPPORT
    select LIRE_LIBDC1394_INST
    help

config LIRE_RACK_LIBJPEG_SUPPORT
    bool "Enable libjpeg support"
    default y
    select LIRE_LIBJPEG_INST
    help

config LIRE_RACK_LIBPNG_SUPPORT
    bool "Enable libpng support"
    default y
    select LIRE_LIBPNG_INST
    select LIRE_RACK_ZLIB_SUPPORT
    help

config LIRE_RACK_OPENCV_SUPPORT
    bool "Enable opencv support"
    default y
    select LIRE_RACK_LIBRAW1394_SUPPORT
    select LIRE_RACK_LIBDC1394_SUPPORT
    select LIRE_RACK_LIBJPEG_SUPPORT
    select LIRE_RACK_LIBPNG_SUPPORT
    select LIRE_OPENCV_INST
    help

config LIRE_RACK_GSL_SUPPORT
    bool "Enable gsl support"
    default y
    select LIRE_GSL_INST
    help

config LIRE_RACK_ZLIB_SUPPORT
    bool "Enable zlib support"
    default y
    select LIRE_ZLIB_INST
    help

config LIRE_RACK_LIBUSB_SUPPORT
    bool "Enable libusb support"
    default y
    select LIRE_LIBUSB_INST
    help

config LIRE_RACK_BOOST_SUPPORT
    bool "Enable boost support for RACK"
    default y
    select LIRE_BOOST_INST
    help

config LIRE_RACK_PCL_SUPPORT
    bool "Enable point cloud library support for RACK"
    default y
    select LIRE_PCL_INST
    help

endmenu

menu "  Rack Target Configuration"
    depends on LIRE_RACK_INST

comment "TiMS"

config LIRE_RACK_TARGET_TIMS_RTNET_CONFIG
    string "RTnet config file on target"
    default ""
    help

config LIRE_RACK_TARGET_TIMS_RTNET_BUFFERS
    int "Number of RTnet buffers (rtskb) in TiMS kernel module"
    default 200
    help

config LIRE_RACK_TARGET_TIMS_MSG_SIZE
    int "Max Message size (in KByte)"
    default 4096
    help

config LIRE_RACK_TARGET_TIMS_MSG_SLOTS
    int "Max Message slots"
    default 2
    help

config LIRE_RACK_TARGET_TIMS_DRIVER_LOG_LEVEL
    int "Driver module log level"
    default 2
    help
    Log Level 0-5

config LIRE_RACK_TARGET_TIMS_CLOCK_SYNC_MODE
    int "TIMS Clock Sync Mode"
    default 0
    help
    SYNC_NONE           0
    SYNC_RTNET          1
    SYNC_CAN_MASTER     2
    SYNC_CAN_SLAVE      3
    SYNC_SER_MASTER     4
    SYNC_SER_SLAVE      5
				    
config LIRE_RACK_TARGET_TIMS_CLOCK_SYNC_DEV
    string "TIMS Clock Sync Device"
    default ""
				    
config LIRE_RACK_TARGET_TIMS_CLOCK_SYNC_CAN_ID
    int "TIMS CAN ID"
    default 0
						    

comment "TiMS Message Client"

config LIRE_RACK_TARGET_TIMS_CLIENT_START
    bool "Start client"
    default y
    help
    ...text...

config LIRE_RACK_TARGET_TIMS_CLIENT_ROUTER_IP
    string "Connect to Router IP"
    default 127.0.0.1
    help
    ...text...

config LIRE_RACK_TARGET_TIMS_CLIENT_ROUTER_PORT
    int "Connect to Server Port"
    default 2000
    help
    ...text...

config LIRE_RACK_TARGET_TIMS_CLIENT_LOG_LEVEL
    int "Log level"
    default 0
    help
    Log Level 0,1 or 2

comment "TiMS Message Server"

config LIRE_RACK_TARGET_TIMS_ROUTER_START
    bool "Start Server"
    default y
    help
    ...text...

config LIRE_RACK_TARGET_TIMS_ROUTER_LISTEN_IP
    string "Listen for clients with IP"
    default ""
    help
    ...text...

config LIRE_RACK_TARGET_TIMS_ROUTER_PORT
    int "Listen on Port"
    default 2000
    help
    ...text...

config LIRE_RACK_TARGET_TIMS_ROUTER_LOG_LEVEL
    int "Log level"
    default 0
    help
    Log Level 0,1 or 2

config LIRE_RACK_TARGET_TIMS_ROUTER_LOG_PATH
    string "Log path"
    default "/data/logs"
    help
    Log path for the tims_router_tcp created log files

config LIRE_RACK_TARGET_TIMS_ROUTER_LOG_MOUNTDEV
    string "mounting device"
    default "/dev/sdb0"
    help
    mounting device for the logging destination

config LIRE_RACK_TARGET_TIMS_ROUTER_LOG_MOUNTPOINT
    string "mounting point"
    default "/data"
    help
    mounting point for the writable data partition



endmenu
```

## packages/rack_rts/Kconfig
```kconfig
config LIRE_RACK_RTS_INST
    bool "  Install RACK-RTS (not public)"
    default n
    select LIRE_RACK_INST
    help
```

## packages/rack_scnd/Kconfig
```kconfig
config LIRE_RACK_SCND_INST
    bool "  Install RACK kernel misc for second kernel"
    default y
    select LIRE_XENOMAI_SCND_INST
    help
    Installs RACK kernel modules for the second kernel.
```

## packages/rackcore/Kconfig
```kconfig
config LIRE_RACKCORE_INST
    bool "  Install Robotic Application Construction Kit (RACK) core"
    default y
    select LIRE_XENOMAI_SCND_INST
    help

menu "  Dependencies"

depends on LIRE_RACKCORE_INST

config LIRE_RACKCORE_LIBJPEG_SUPPORT
    bool "Enable libjpeg support"
    default y
    select LIRE_LIBJPEG_INST
    help

config LIRE_RACKCORE_LIBPNG_SUPPORT
    bool "Enable libpng support"
    default y
    select LIRE_LIBPNG_INST
    select LIRE_RACKCORE_ZLIB_SUPPORT
    help

config LIRE_RACKCORE_OPENCV_SUPPORT
    bool "Enable OpenCV support"
    default y
    select LIRE_RACKCORE_LIBJPEG_SUPPORT
    select LIRE_RACKCORE_LIBPNG_SUPPORT
    select LIRE_OPENCV_INST
    help

config LIRE_RACKCORE_ZLIB_SUPPORT
    bool "Enable zlib support"
    default y
    select LIRE_ZLIB_INST
    help

config LIRE_RACKCORE_LIBUSB_SUPPORT
    bool "Enable libusb support"
    default n
    select LIRE_LIBUSB_INST
    help

config LIRE_RACKCORE_BOOST_SUPPORT
    bool "Enable boost support for RACK"
    default y
    select LIRE_BOOST_INST
    help

config LIRE_RACKCORE_PCL_SUPPORT
    bool "Enable point cloud library support for RACK"
    default y
    select LIRE_PCL_INST
    help

config LIRE_RACKCORE_CURL_SUPPORT
    bool "Enable cURL support for RACK"
    default y
    select LIRE_CURL_INST
    help

config LIRE_RACKCORE_EIGEN_SUPPORT
    bool "Enable Eigen support for RACK"
    default y
    select LIRE_EIGEN_INST
    help

config LIRE_RACKCORE_OPENSSL_SUPPORT
    bool "Enable OpenSSL support for RACK"
    default y
    select LIRE_OPENSSL_INST
    help

endmenu

menu "  Rack Target Configuration"
    depends on LIRE_RACKCORE_INST

comment "TiMS"

config LIRE_RACKCORE_TARGET_TIMS_RTNET_CONFIG
    string "RTnet config file on target"
    default ""
    help

config LIRE_RACKCORE_TARGET_TIMS_RTNET_BUFFERS
    int "Number of RTnet buffers (rtskb) in TiMS kernel module"
    default 200
    help

config LIRE_RACKCORE_TARGET_TIMS_MSG_SIZE
    int "Max Message size (in KByte)"
    default 4096
    help

config LIRE_RACKCORE_TARGET_TIMS_MSG_SLOTS
    int "Max Message slots"
    default 2
    help

config LIRE_RACKCORE_TARGET_TIMS_DRIVER_LOG_LEVEL
    int "Driver module log level"
    default 1
    help
    Log Level 0-5

config LIRE_RACKCORE_TARGET_TIMS_CLOCK_SYNC_MODE
    int "TIMS Clock Sync Mode"
    default 0
    help
    SYNC_NONE           0
    SYNC_RTNET          1
    SYNC_CAN_MASTER     2
    SYNC_CAN_SLAVE      3
    SYNC_SER_MASTER     4
    SYNC_SER_SLAVE      5
				    
config LIRE_RACKCORE_TARGET_TIMS_CLOCK_SYNC_DEV
    string "TIMS Clock Sync Device"
    default ""
				    
config LIRE_RACKCORE_TARGET_TIMS_CLOCK_SYNC_CAN_ID
    int "TIMS CAN ID"
    default 0
						    

comment "TiMS Message Client"

config LIRE_RACKCORE_TARGET_TIMS_CLIENT_START
    bool "Start client"
    default y
    help
    ...text...

config LIRE_RACKCORE_TARGET_TIMS_CLIENT_ROUTER_IP
    string "Connect to Router IP"
    default 127.0.0.1
    help
    ...text...

config LIRE_RACKCORE_TARGET_TIMS_CLIENT_ROUTER_PORT
    int "Connect to Server Port"
    default 2000
    help
    ...text...

config LIRE_RACKCORE_TARGET_TIMS_CLIENT_LOG_LEVEL
    int "Log level"
    default 0
    help
    Log Level 0,1 or 2

comment "TiMS Message Server"

config LIRE_RACKCORE_TARGET_TIMS_ROUTER_START
    bool "Start Server"
    default y
    help
    ...text...

config LIRE_RACKCORE_TARGET_TIMS_ROUTER_LISTEN_IP
    string "Listen for clients with IP"
    default ""
    help
    ...text...

config LIRE_RACKCORE_TARGET_TIMS_ROUTER_PORT
    int "Listen on Port"
    default 2000
    help
    ...text...

config LIRE_RACKCORE_TARGET_TIMS_ROUTER_LOG_LEVEL
    int "Log level"
    default 0
    help
    Log Level 0,1 or 2

config LIRE_RACKCORE_TARGET_TIMS_ROUTER_LOG_PATH
    string "Log path"
    default "/data/logs"
    help
    Log path for the tims_router_tcp created log files

endmenu
```

## packages/ros_comm/Kconfig
```kconfig
config LIRE_ROS_COMM_INST
    bool "  Install ros_comm"
    default n 
    select LIRE_ROSCPP_CORE_INST
    select LIRE_ROS_CORE_INST
    select LIRE_LZ4_INST
    select LIRE_BOOST_INST
    select LIRE_ROS_CORE_INST
    select LIRE_CONSOLE_BRIDGE_INST
    select LIRE_BZIP2_INST
    select LIRE_STD_MSGS_INST
    select LIRE_GENCPP_INST
    select LIRE_GENMSG_INST
    select LIRE_GENPY_INST
    select LIRE_GENLISP_INST
    select LIRE_ROS_COMM_MSGS_INST
    select LIRE_MESSAGE_RUNTIME_INST
    select LIRE_MESSAGE_GENERATION_INST
    select LIRE_PYTHON_INST
    select LIRE_PYYAML_INST
    help
    ...text...
```

## packages/ros_comm_msgs/Kconfig
```kconfig
config LIRE_ROS_COMM_MSGS_INST
    bool "  Install ros_comm_msgs"
    default n 
    select LIRE_STD_MSGS_INST
    select LIRE_MESSAGE_RUNTIME_INST
    select LIRE_MESSAGE_GENERATION_INST
    select LIRE_ROSCPP_CORE_INST
    help
    ...text...
```

## packages/ros_core/Kconfig
```kconfig
config LIRE_ROS_CORE_INST
    bool "  Install ROS core packages"
    default n 
    select LIRE_CATKIN_INST
    select LIRE_ROSPACK_INST
    select LIRE_BOOST_INST
    help
    ...text...
```

## packages/roscpp_core/Kconfig
```kconfig
config LIRE_ROSCPP_CORE_INST
    bool "  Install roscpp_core"
    default n 
    select LIRE_BOOST_INST
    select LIRE_CATKIN_INST
    select LIRE_CONSOLE_BRIDGE_INST
    help
    ...text...
```

## packages/rospack/Kconfig
```kconfig
config LIRE_ROSPACK_INST
    bool "  Install rospack"
    default n 
    select LIRE_CATKIN_INST
    select LIRE_BOOST_INST
    select LIRE_CMAKE_MODULES_INST
    select LIRE_LIBTINYXML_INST
    select LIRE_PYTHON_INST
    help
    ...text...
```

## packages/rospkg/Kconfig
```kconfig
config LIRE_ROSPKG_INST
    bool "  Install rospkg on target"
    default n 
    select LIRE_PYTHON_INST
    select LIRE_SETUPTOOLS_INST
    select LIRE_PYYAML_INST
    help
    ...text...
```

## packages/rtnet/Kconfig
```kconfig
config LIRE_RTNET_INST
    bool "  Install RTnet"
    default y
    select LIRE_XENOMAI_INST
    help
    ...text...


menu "  RTnet Configuration"

depends on LIRE_RTNET_INST

config LIRE_RTNET_TARGET_AUTOSTART
    bool "Run on start-up"
    help
    ...text...

comment "RTnet parameters"

config LIRE_RTNET_TARGET_DRIVER
    string "RTnet network driver"
    default "rt_eepro100"
    help
    ...text...

config LIRE_RTNET_TARGET_IP
    string "RTnet IP"
    default "10.0.0.1"
    help
    ...text...

choice
    prompt "RTnet TDMA Mode"

    config LIRE_RTNET_TARGET_TDMA_MODE_MASTER
    bool "master"

    config LIRE_RTNET_TARGET_TDMA_MODE_SLAVE
    bool "slave"
endchoice

config LIRE_RTNET_TARGET_SLAVES
    string "RTnet Slaves"
    default "10.0.0.2 10.0.0.3"

comment "Linux networking"

config LIRE_RTNET_TARGET_NORMAL_NET
    bool "Start 2nd NIC under Linux"
    default y

config LIRE_RTNET_TARGET_ROUTING
    bool "Use master as transparent router"
    default y

endmenu
```

## packages/rtnet_scnd/Kconfig
```kconfig
config LIRE_RTNET_SCND_INST
    bool "  Install rtnet for a _SECOND_ kernel"
    default y
    select LIRE_XENOMAI_SCND_INST
    help
    Installs rtnet kernel modules for a second kernel.
```

## packages/sdl_image/Kconfig
```kconfig
config LIRE_SDL_IMAGE_INST
    bool "  Install SDL-Image"
    default n
    select LIRE_LIBPNG_INST
    select LIRE_LIBJPEG_INST
    select LIRE_LIBSDL_INST
    select LIRE_ZLIB_INST
    help
```

## packages/sensorkinect/Kconfig
```kconfig
config LIRE_SENSORKINECT_INST
    bool "  Install Kinect camera driver lib based on OpenNI (by avin2)"
    default y
    select LIRE_OPENNI_INST
    help
    ...text...
```

## packages/setserial/Kconfig
```kconfig
config LIRE_SETSERIAL_INST
    bool "  Install setserial"
    default y
    help
    ...text...
```
