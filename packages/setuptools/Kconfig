## packages/setuptools/Kconfig
```kconfig
config LIRE_SETUPTOOLS_INST
    bool "  Install setuptools"
    default n 
    depends on LIRE_PYTHON_INST
    help
    ...text...
```

## packages/ssdp_responder/Kconfig
```kconfig
config LIRE_SSDP_RESPONDER_INST
    bool "  Install ssdp-responder"
    default n
    help
    Installs ssdp-responder.
```

## packages/std_msgs/Kconfig
```kconfig
config LIRE_STD_MSGS_INST
    bool "  Install std_msgs"
    default n 
    select LIRE_CATKIN_INST
    select LIRE_MESSAGE_GENERATION_INST
    select LIRE_GENMSG_INST
    select LIRE_GENCPP_INST
    select LIRE_GENLISP_INST
    select LIRE_GENPY_INST
    help
    ...text...
```

## packages/tinyxml2/Kconfig
```kconfig
config LIRE_TINYXML2_INST
    bool "  Install TinyXML-2"
    default n
    help
    ...text...
```

## packages/wireless_tools/Kconfig
```kconfig
config LIRE_WIRELESS_TOOLS_INST
    bool "  Install Wireless Tools"
    default y
    help
    Install wireless-tools (e.g. to get commands like 'iwconfig', 'iwlist')
```

## packages/wlanpoll/Kconfig
```kconfig
config LIRE_WLANPOLL_INST
    bool "  Install Wlanpoll"
    default y
    depends on LIRE_WIRELESS_TOOLS_INST
    help
    Install wlanpoll to automatically (re-)connect to (new) APs if current link quality goes below a given value
```

## packages/wpa_supplicant/Kconfig
```kconfig
config LIRE_WPA_SUPPLICANT_INST
    bool "  Install wpa_supplicant"
    default y
    select LIRE_OPENSSL_INST
    help
    This program is needed to be able to connect LiRE to WPA encrypted wireless network.
```

## packages/xenomai/Kconfig
```kconfig
config LIRE_XENOMAI_INST
    bool "  Install Xenomai Real-Time Extension"
    default y
    help
    ...text...
```

## packages/xenomai_scnd/Kconfig
```kconfig
config LIRE_XENOMAI_SCND_INST
    bool "  Install Xenomai for a _SECOND_ kernel"
    default y
    select LIRE_LINUX_SCND_INST
    help
    Installs the xenomai patch for a *SECOND* kernel. Unselect if you do *NOT* need a second one.
    Unselect also, if you do *NOT* want to have the second one xenomai patched.
```

## packages/yaml_cpp/Kconfig
```kconfig
config LIRE_YAML_CPP_INST
    bool "  Install yaml-cpp"
    default n 
    select LIRE_BOOST_INST
    help
    ...text...
```

## packages/zlib/Kconfig
```kconfig
config LIRE_ZLIB_INST
    bool "  Install zlib"
    default y
    help
    ...text...
```

## src/Kconfig
```kconfig
menu "Build"

config LIRE_BUILD_SRC
    bool "  Build sources"
    default y
    help
    Build LIRE sources.

    depends on LIRE_BUILD_SRC

config LIRE_BUILD_ALL
    bool "    Build all packages"
    default n
    depends on LIRE_BUILD_SRC

    select LIRE_LINUX_BUILD_SRC
    select LIRE_BUSYBOX_BUILD_SRC
    select LIRE_XENOMAI_BUILD_SRC 		if LIRE_XENOMAI_INST
    select LIRE_NANO_BUILD_SRC			if LIRE_NANO_INST
    select LIRE_WIRELESS_TOOLS_BUILD_SRC	if LIRE_WIRELESS_TOOLS_INST
    select LIRE_OPENSSL_BUILD_SRC		if LIRE_OPENSSL_INST
    select LIRE_OPENSSH_BUILD_SRC		if LIRE_OPENSSH_INST
    select LIRE_RACKCORE_BUILD_SRC		if LIRE_RACKCORE_INST
#    select LIRE_RACK_RTS_BUILD_SRC		if LIRE_RACK_RTS_INST
    select LIRE_RTNET_BUILD_SRC			if LIRE_RTNET_INST
    select LIRE_OPENCV_BUILD_SRC		if LIRE_OPENCV_INST
    select LIRE_LIBDC1394_BUILD_SRC		if LIRE_LIBDC1394_INST
    select LIRE_LIBRAW1394_BUILD_SRC		if LIRE_LIBRAW1394_INST
    select LIRE_LIBJPEG_BUILD_SRC		if LIRE_LIBJPEG_INST
    select LIRE_LIBPNG_BUILD_SRC		if LIRE_LIBPNG_INST
    select LIRE_OPENVPN_BUILD_SRC		if LIRE_OPENVPN_INST
    select LIRE_PCIUTILS_BUILD_SRC		if LIRE_PCIUTILS_INST
    select LIRE_HDPARM_BUILD_SRC		if LIRE_HDPARM_INST
    select LIRE_LINUX_SCND_BUILD_SRC		if LIRE_LINUX_SCND_INST
    select LIRE_XENOMAI_SCND_BUILD_SRC		if LIRE_XENOMAI_SCND_INST
    select LIRE_RTNET_SCND_BUILD_SRC		if LIRE_RTNET_SCND_INST
#    select LIRE_RACK_SCND_BUILD_SRC		if LIRE_RACK_SCND_INST
    select LIRE_GSL_BUILD_SRC           	if LIRE_GSL_INST
    select LIRE_E2FSPROGS_BUILD_SRC		if LIRE_E2FSPROGS_INST
    select LIRE_PARTED_BUILD_SRC		if LIRE_PARTED_INST
    select LIRE_WLANPOLL_BUILD_SRC      	if LIRE_WLANPOLL_INST
    select LIRE_LIBUSB_BUILD_SRC        	if LIRE_LIBUSB_INST
    select LIRE_SETSERIAL_BUILD_SRC     	if LIRE_SETSERIAL_INST
    select LIRE_IPROUTE2_BUILD_SRC      	if LIRE_IPROUTE2_INST
    select LIRE_DHCPCD_BUILD_SRC        	if LIRE_DHCPCD_INST
    select LIRE_WPA_SUPPLICANT_BUILD_SRC    	if LIRE_WPA_SUPPLICANT_INST
    select LIRE_EXPAT_BUILD_SRC         	if LIRE_EXPAT_INST
    select LIRE_BOOST_BUILD_SRC         	if LIRE_BOOST_INST
    select LIRE_BZIP2_BUILD_SRC         	if LIRE_BZIP2_INST
    select LIRE_FLANN_BUILD_SRC         	if LIRE_FLANN_INST
    select LIRE_PCL_BUILD_SRC           	if LIRE_PCL_INST
    select LIRE_OPENNI_BUILD_SRC        	if LIRE_OPENNI_INST
    select LIRE_PRIMESENSE_BUILD_SRC		if LIRE_PRIMESENSE_INST
    select LIRE_SENSORKINECT_BUILD_SRC		if LIRE_SENSORKINECT_INST
    select LIRE_CATKIN_BUILD_SRC		if LIRE_CATKIN_INST
    select LIRE_CATKIN_PKG_BUILD_SRC		if LIRE_CATKIN_PKG_INST
    select LIRE_CMAKE_MODULES_BUILD_SRC		if LIRE_CMAKE_MODULES_INST
    select LIRE_CONSOLE_BRIDGE_BUILD_SRC	if LIRE_CONSOLE_BRIDGE_INST
    select LIRE_EMPY_BUILD_SRC			if LIRE_EMPY_INST
    select LIRE_GENCPP_BUILD_SRC		if LIRE_GENCPP_INST
    select LIRE_GENLISP_BUILD_SRC		if LIRE_GENLISP_INST
    select LIRE_GENMSG_BUILD_SRC		if LIRE_GENMSG_INST
    select LIRE_GENPY_BUILD_SRC 		if LIRE_GENPY_INST
    select LIRE_LIBTINYXML_BUILD_SRC 		if LIRE_LIBTINYXML_INST
    select LIRE_LZ4_BUILD_SRC 			if LIRE_LZ4_INST
    select LIRE_MESSAGE_GENERATION_BUILD_SRC	if LIRE_MESSAGE_GENERATION_INST
    select LIRE_MESSAGE_RUNTIME_BUILD_SRC	if LIRE_MESSAGE_RUNTIME_INST
    select LIRE_PYTHON_BUILD_SRC 		if LIRE_PYTHON_INST
    select LIRE_PYYAML_BUILD_SRC 		if LIRE_PYYAML_INST
    select LIRE_ROS_COMM_BUILD_SRC 		if LIRE_ROS_COMM_INST
    select LIRE_ROS_COMM_MSGS_BUILD_SRC 	if LIRE_ROS_COMM_MSGS_INST
    select LIRE_ROS_CORE_BUILD_SRC 		if LIRE_ROS_CORE_INST
    select LIRE_ROSCPP_CORE_BUILD_SRC 		if LIRE_ROSCPP_CORE_INST
    select LIRE_ROSPACK_BUILD_SRC 		if LIRE_ROSPACK_INST
    select LIRE_STD_MSGS_BUILD_SRC 		if LIRE_STD_MSGS_INST
    select LIRE_TINYXML2_BUILD_SRC 		if LIRE_TINYXML2_INST
    select LIRE_CURL_BUILD_SRC 			if LIRE_CURL_INST
    select LIRE_ROSPKG_BUILD_SRC 		if LIRE_ROSPKG_INST
    select LIRE_SETUPTOOLS_BUILD_SRC 		if LIRE_SETUPTOOLS_INST
    select LIRE_NETIFACES_BUILD_SRC 		if LIRE_NETIFACES_INST
    select LIRE_COMMON_MSGS_BUILD_SRC 		if LIRE_COMMON_MSGS_INST
    select LIRE_LIBRACKRTROS_BUILD_SRC		if LIRE_LIBRACKRTROS_INST
    select LIRE_LIBRTROS_BUILD_SRC		if LIRE_LIBRTROS_INST
    select LIRE_GEOMETRY_BUILD_SRC		if LIRE_GEOMETRY_INST
    select LIRE_LIBSDL_BUILD_SRC		if LIRE_LIBSDL_INST
    select LIRE_SDL_IMAGE_BUILD_SRC		if LIRE_SDL_IMAGE_INST
    select LIRE_YAML_CPP_BUILD_SRC		if LIRE_YAML_CPP_INST
    select LIRE_OROCOS_BFL_BUILD_SRC		if LIRE_OROCOS_BFL_INST
    select LIRE_OPENDDS_BUILD_SRC		if LIRE_OPENDDS_INST
    select LIRE_LIBSOCKETCAN_BUILD_SRC		if LIRE_LIBSOCKETCAN_INST
    select LIRE_SSDP_RESPONDER_BUILD_SRC	if LIRE_SSDP_RESPONDER_INST


source "src/linux/Kconfig"    
source "src/xenomai/Kconfig"
source "src/busybox/Kconfig"

comment "*SECOND* Kernel Build Options"
source "src/linux_scnd/Kconfig"
source "src/xenomai_scnd/Kconfig"
source "src/rtnet_scnd/Kconfig"
#source "src/rack_scnd/Kconfig"

comment "  Applications"
    depends on LIRE_BUILD_SRC
source "src/opencv/Kconfig"
source "src/openvpn/Kconfig"
source "src/openssl/Kconfig"
source "src/openssh/Kconfig"
source "src/nano/Kconfig"
source "src/pciutils/Kconfig"
source "src/hdparm/Kconfig"
source "src/e2fsprogs/Kconfig"
source "src/parted/Kconfig"
source "src/iproute2/Kconfig"
source "src/setserial/Kconfig"
source "src/dhcpcd/Kconfig"
source "src/tinyxml2/Kconfig"
source "src/opendds/Kconfig"
source "src/ssdp_responder/Kconfig"

comment "  Python"
    depends on LIRE_BUILD_SRC
source "src/python/Kconfig"
source "src/empy/Kconfig"
source "src/setuptools/Kconfig"
source "src/pyyaml/Kconfig"
source "src/netifaces/Kconfig"

comment "  WLAN"
    depends on LIRE_BUILD_SRC
source "src/wireless_tools/Kconfig"
source "src/wlanpoll/Kconfig"
source "src/wpa_supplicant/Kconfig"

comment "  Drivers"
    depends on LIRE_BUILD_SRC
source "src/rtnet/Kconfig"

comment "  RACK"
    depends on LIRE_BUILD_SRC
source "src/rackcore/Kconfig"
#source "src/rack_rts/Kconfig"
source "src/librackrtros/Kconfig"

comment "  ROS"
    depends on LIRE_BUILD_SRC
source "src/catkin_pkg/Kconfig"
source "src/catkin/Kconfig"
source "src/rospkg/Kconfig"
source "src/cmake_modules/Kconfig"
source "src/rospack/Kconfig"
source "src/roscpp_core/Kconfig"
source "src/ros_core/Kconfig"
source "src/genmsg/Kconfig"
source "src/gencpp/Kconfig"
source "src/genpy/Kconfig"
source "src/genlisp/Kconfig"
source "src/message_generation/Kconfig"
source "src/message_runtime/Kconfig"
source "src/std_msgs/Kconfig"
source "src/ros_comm_msgs/Kconfig"
source "src/ros_comm/Kconfig"
source "src/common_msgs/Kconfig"
source "src/librtros/Kconfig"
source "src/geometry/Kconfig"
source "src/orocos_bfl/Kconfig"

comment "  Libraries"
    depends on LIRE_BUILD_SRC
source "src/libraw1394/Kconfig"
source "src/libdc1394/Kconfig"
source "src/libpng/Kconfig"
source "src/libjpeg/Kconfig"
source "src/libsepol/Kconfig"
source "src/libselinux/Kconfig"
source "src/ncurses/Kconfig"
source "src/zlib/Kconfig"
source "src/gsl/Kconfig"
source "src/libusb/Kconfig"
source "src/expat/Kconfig"
source "src/boost/Kconfig"
source "src/bzip2/Kconfig"
source "src/eigen/Kconfig"
source "src/flann/Kconfig"
source "src/pcl/Kconfig"
source "src/libsocketcan/Kconfig"
source "src/openni/Kconfig"
source "src/primesense/Kconfig"
source "src/sensorkinect/Kconfig"
source "src/console_bridge/Kconfig"
source "src/lz4/Kconfig"
source "src/libtinyxml/Kconfig"
source "src/libsdl/Kconfig"
source "src/sdl_image/Kconfig"
source "src/yaml_cpp/Kconfig"
source "src/curl/Kconfig"

#comment "  Special Packages"
#    depends on LIRE_BUILD_SRC


comment "Configuration"

config LIRE_BUILD_SRC_DOWNLOAD_DIR
    string "Source download directory"
    default "/YOUR/PATH/LiRE-0.9-betaX/sources"
    help
    ...

config LIRE_BUILDDIR
    string "LIRE build directory"
    default "/YOUR/PATH/LiRE-0.9-betaX/builddir"
    help
    Relative or absolute name of the build directory,
    e.g. /tmp/builddir (absolute) or builddir (relative).
    WARNING !! Do not use relative paths into parent directories (../../XYZ)

config LIRE_INSTDIR
    string "LIRE install directory"
    default "/YOUR/PATH/LiRE-0.9-betaX/installdir"
    help
    Relative or absolute name of the install directory,
    e.g. /tmp/instdir (absolute) or instdir (relative).
    WARNING !! Do not use relative paths into parent directories (../../XYZ)

config LIRE_HOSTDIR
    string "LIRE host files directory"
    default "/YOUR/PATH/LiRE-0.9-betaX/hostdir"
    help
    Relative or absolute name of the host files directory,
    e.g. /tmp/instdir (absolute) or instdir (relative).
    WARNING !! Do not use relative paths into parent directories (../../XYZ)

config LIRE_CMAKE_DIR
    string "Directory where to find an alternative cmake binary to use"
    default ""
    help
    LiRE can use a different cmake binary than the system one
    (e.g. if you compiled a newer version inside /opt or your home directory).

config LIRE_CROSS_COMPILE
    bool "Use own toolchain"
    default y

config LIRE_TARGET_ARCH
    string "main ARCH string of the target"
    default x86
    depends on LIRE_CROSS_COMPILE

config LIRE_TARGET_TUPLE
    string "target tuple or alias"
    default i586-nptl-linux-gnu
    depends on LIRE_CROSS_COMPILE

config LIRE_TOOLCHAIN_PARENT_DIR
    string "Parent directory of the toolchain"
    default /opt
    depends on LIRE_CROSS_COMPILE

config LIRE_BUILD_JOBS
    int "Number of jobs to build the sources"
    default 8
    help
    If you use distcc or icecream, you can specify the number of compile-jobs.

config LIRE_BUILD_BLEEDING_EDGE
    bool "Build bleeding edge (experimental)"
    default n
    help
    make update automatically chooses the unstable package and make build automatically 
    chooses the latest config file, if activated
    EXPERIMENTAL, USE WITH CAUTION. MAY BREAK THE BUILD PROCESS

config LIRE_BUILD_CONFIGS_LOG
    string "logfile of selected configs"
    default ""
    help
    In this logfile will be stored, which configfile has been selected 
    during the build process. 
    If this value is empty, no log file will be created.

endmenu
```

## src/boost/Kconfig
```kconfig
config LIRE_BOOST_BUILD_SRC
    bool "    Build Boost libraries"
    default y
    depends on LIRE_BUILD_SRC && LIRE_BOOST_INST
    select LIRE_EXPAT_BUILD_SRC
    select LIRE_BZIP2_BUILD_SRC
    help
    ...
```

## src/busybox/Kconfig
```kconfig
config LIRE_BUSYBOX_BUILD_SRC
    bool "    Build new busybox"
    default y
    depends on LIRE_BUILD_SRC
    help
    ...
```

## src/bzip2/Kconfig
```kconfig
config LIRE_BZIP2_BUILD_SRC
    bool "    Build bzip2"
    default y
    depends on LIRE_BUILD_SRC && LIRE_BZIP2_INST
    help
    ...
```

## src/catkin/Kconfig
```kconfig
config LIRE_CATKIN_BUILD_SRC
    bool "    Include catkin in host based Python"
    default n
    depends on LIRE_BUILD_SRC && LIRE_CATKIN_INST
    select LIRE_CATKIN_PKG_BUILD_SRC
    select LIRE_EMPY_BUILD_SRC
    select LIRE_PYTHON_BUILD_SRC
    help
    ...
```

## src/catkin_pkg/Kconfig
```kconfig
config LIRE_CATKIN_PKG_BUILD_SRC
    bool "    Include catkin_pkg in host based Python"
    default n
    depends on LIRE_PYTHON_BUILD_SRC
    help
    ...
```

## src/cmake_modules/Kconfig
```kconfig
config LIRE_CMAKE_MODULES_BUILD_SRC
    bool "    Build cmake_modules"
    default n
    depends on LIRE_BUILD_SRC && LIRE_CMAKE_MODULES_INST
    select LIRE_CATKIN_BUILD_SRC
    select LIRE_LIBTINYXML_BUILD_SRC
    help
	...
```

## src/common_msgs/Kconfig
```kconfig
config LIRE_COMMON_MSGS_BUILD_SRC
    bool "    Build common_msgs"
    default n
    depends on LIRE_BUILD_SRC && LIRE_COMMON_MSGS_INST
    select LIRE_CATKIN_BUILD_SRC
    select LIRE_MESSAGE_GENERATION_BUILD_SRC
    select LIRE_MESSAGE_RUNTIME_BUILD_SRC
    select LIRE_STD_MSGS_BUILD_SRC
    select LIRE_ROSCPP_CORE_BUILD_SRC
    select LIRE_BOOST_BUILD_SRC
    help
	...
```

## src/console_bridge/Kconfig
```kconfig
config LIRE_CONSOLE_BRIDGE_BUILD_SRC
    bool "    Build console-bridge"
    default n
    depends on LIRE_BUILD_SRC && LIRE_CONSOLE_BRIDGE_INST
    select LIRE_BOOST_BUILD_SRC
    help
    ...
```

## src/curl/Kconfig
```kconfig
config LIRE_CURL_BUILD_SRC
    bool "    Build Curl libcurl library"
    default n
    depends on LIRE_BUILD_SRC && LIRE_CURL_INST
    select LIRE_OPENSSL_BUILD_SRC
    select LIRE_ZLIB_BUILD_SRC
    help
    curl is a command line tool and library for transferring data with URL syntax 
```

## src/dhcpcd/Kconfig
```kconfig
config LIRE_DHCPCD_BUILD_SRC
    bool "    Build new dhcpcd"
    default y
    depends on LIRE_DHCPCD_INST && LIRE_BUILD_SRC
    help
    dhcpcd
```

## src/e2fsprogs/Kconfig
```kconfig
config LIRE_E2FSPROGS_BUILD_SRC
    bool "    Build e2fsprogs"
    default y
    depends on LIRE_BUILD_SRC && LIRE_E2FSPROGS_INST
    help
    Build the e2fsprogs package.
```

## src/eigen/Kconfig
```kconfig
config LIRE_EIGEN_BUILD_SRC
    bool "    Build new eigen"
    default y
    depends on LIRE_BUILD_SRC && LIRE_EIGEN_INST
    help
    ...
```

## src/empy/Kconfig
```kconfig
config LIRE_EMPY_BUILD_SRC
    bool "    Include EmPy in HostPython"
    default n
    depends on LIRE_PYTHON_BUILD_SRC
    help
    ...
```
