## packages/iproute2/Kconfig
```kconfig
config LIRE_IPROUTE2_INST
    bool "  Install iproute2"
    default y
    help
    Installs iproute2. This contains mainly the ip command which
    is important for setting CAN baudrates for SocketCAN device drivers.
```

## packages/libdc1394/Kconfig
```kconfig
config LIRE_LIBDC1394_INST
    bool "  Install libdc1394"
    default n
    select LIRE_LIBRAW1394_INST
    help
    ...text...
```

## packages/libjpeg/Kconfig
```kconfig
config LIRE_LIBJPEG_INST
    bool "  Install libjpeg"
    default n
    help
    ...text...
```

## packages/libpng/Kconfig
```kconfig
config LIRE_LIBPNG_INST
    bool "  Install libpng"
    select LIRE_ZLIB_INST
    default n
    help
    ...text...
```

## packages/librackrtros/Kconfig
```kconfig
config LIRE_LIBRACKRTROS_INST
    bool "  Install librackrtros (for RTROS)"
    default y
    select LIRE_XENOMAI_INST
    select LIRE_RACK_INST
    help
```

## packages/libraw1394/Kconfig
```kconfig
config LIRE_LIBRAW1394_INST
    bool "  Install libraw1394"
    default n
    help
    ...text...
```

## packages/librtros/Kconfig
```kconfig
config LIRE_LIBRTROS_INST
    bool "  Install librtros (Real-Time ROS library using TiMS)"
    default n
    select LIRE_XENOMAI_INST
    select LIRE_LIBRACKRTROS_INST
    select LIRE_CATKIN_INST
    select LIRE_ROS_COMM_INST
    help
```

## packages/libselinux/Kconfig
```kconfig
config LIRE_LIBSELINUX_INST
    bool "  Install libselinux"
    depends on LIRE_SELINUX_ENABLE
    default y
    select LIRE_LIBSEPOL_INST
    help
    ...text...
```

## packages/libsepol/Kconfig
```kconfig
config LIRE_LIBSEPOL_INST
    bool "  Install libsepol"
    depends on LIRE_SELINUX_ENABLE
    default y
    help
    ...text...
```

## packages/libsocketcan/Kconfig
```kconfig
config LIRE_LIBSOCKETCAN_INST
    bool "  Install libsocketcan"
    default y
    help
    Installs libsocketcan.
```

## packages/libtinyxml/Kconfig
```kconfig
config LIRE_LIBTINYXML_INST
    bool "  Install TinyXML-1 as library"
    default n
    help
    ...text...
```

## packages/libusb/Kconfig
```kconfig
config LIRE_LIBUSB_INST
    bool "  Install libusb"
    default n
    help
    ...text...
```

## packages/linux_scnd/Kconfig
```kconfig
config LIRE_LINUX_SCND_INST
    bool "  Installs a _SECOND_ kernel"
    default y
    help
    Installs a *SECOND* kernel. Unselect if you do *NOT* need a second one.
```

## packages/lz4/Kconfig
```kconfig
config LIRE_LZ4_INST
    bool "  Install lz4"
    default n
    help
    ...text...
```

## packages/message_generation/Kconfig
```kconfig
config LIRE_MESSAGE_GENERATION_INST
    bool "  Install message_generation"
    default n 
    select LIRE_CATKIN_INST
    select LIRE_GENMSG_INST
    select LIRE_GENCPP_INST
    select LIRE_GENPY_INST
    select LIRE_GENLISP_INST
    help
    ...text...
```

## packages/message_runtime/Kconfig
```kconfig
config LIRE_MESSAGE_RUNTIME_INST
    bool "  Install message_runtime"
    default n 
    select LIRE_CATKIN_INST
    select LIRE_GENPY_INST
    select LIRE_ROSCPP_CORE_INST
    help
    ...text...
```

## packages/nano/Kconfig
```kconfig
config LIRE_NANO_INST
    bool "  Install Nano(pico) Editor"
    default y
    select LIRE_NCURSES_INST
    help
    ...text...
```

## packages/ncurses/Kconfig
```kconfig
config LIRE_NCURSES_INST
    bool "  Install ncurses Library"
    default y 
    help
    ...text...
```

## packages/netifaces/Kconfig
```kconfig
config LIRE_NETIFACES_INST
    bool "  Install netifaces on target"
    default n 
    depends on LIRE_PYTHON_INST
    select LIRE_SETUPTOOLS_INST
    help
    ...text...
```

## packages/opencv/Kconfig
```kconfig
config LIRE_OPENCV_INST
    bool "  Install OpenCV"
    default y
    select LIRE_LIBPNG_INST
    select LIRE_LIBJPEG_INST
    select LIRE_ZLIB_INST
    help
```

## packages/opendds/Kconfig
```kconfig
config LIRE_OPENDDS_INST
    bool "  Install OpenDDS"
    default n
    help
    ...text...
```

## packages/openni/Kconfig
```kconfig
config LIRE_OPENNI_INST
    bool "  Install OpenNI"
    default y
    select LIRE_LIBUSB_INST
    help
    ...text...
```

## packages/openssh/Kconfig
```kconfig
config LIRE_OPENSSH_INST
    bool "  Install OpenSSH"
    select LIRE_ZLIB_INST
    select LIRE_OPENSSL_INST
    default y
    help
    ...text...
```

## packages/openssl/Kconfig
```kconfig
config LIRE_OPENSSL_INST
    bool "  Install OpenSSL"
    default y
    help
    ...text...
```
