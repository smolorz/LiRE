## src/expat/Kconfig
```kconfig
config LIRE_EXPAT_BUILD_SRC
    bool "    Build Expat XML Parser"
    default y
    depends on LIRE_BUILD_SRC && LIRE_EXPAT_INST
    help
    ...
```

## src/flann/Kconfig
```kconfig
config LIRE_FLANN_BUILD_SRC
    bool "    Build new flann"
    default y
    depends on LIRE_BUILD_SRC && LIRE_FLANN_INST
    help
    ...
```

## src/gencpp/Kconfig
```kconfig
config LIRE_GENCPP_BUILD_SRC
    bool "    Build gencpp"
    default n
    depends on LIRE_BUILD_SRC && LIRE_GENCPP_INST
    select LIRE_CATKIN_BUILD_SRC
    select LIRE_GENMSG_BUILD_SRC
    help
	...
```

## src/genlisp/Kconfig
```kconfig
config LIRE_GENLISP_BUILD_SRC
    bool "    Build genlisp"
    default n
    depends on LIRE_BUILD_SRC && LIRE_GENLISP_INST
    select LIRE_CATKIN_BUILD_SRC
    select LIRE_GENMSG_BUILD_SRC
    help
	...
```

## src/genmsg/Kconfig
```kconfig
config LIRE_GENMSG_BUILD_SRC
    bool "    Build genmsg"
    default n
    depends on LIRE_BUILD_SRC && LIRE_GENMSG_INST
    select LIRE_CATKIN_BUILD_SRC
    help
	...
```

## src/genpy/Kconfig
```kconfig
config LIRE_GENPY_BUILD_SRC
    bool "    Build genpy"
    default n
    depends on LIRE_BUILD_SRC && LIRE_GENPY_INST
    select LIRE_CATKIN_BUILD_SRC
    select LIRE_GENMSG_BUILD_SRC
    help
	...
```

## src/geometry/Kconfig
```kconfig
config LIRE_GEOMETRY_BUILD_SRC
    bool "    Build ROS geometry package (including tf)"
    default n
    depends on LIRE_BUILD_SRC && LIRE_GEOMETRY_INST
    select LIRE_ROS_COMM_BUILD_SRC
    select LIRE_STD_MSGS_BUILD_SRC
    select LIRE_COMMON_MSGS_BUILD_SRC
    select LIRE_MESSAGE_GENERATION_BUILD_SRC
    select LIRE_PYTHON_BUILD_SRC
    select LIRE_BOOST_BUILD_SRC
    help
	...
```

## src/gsl/Kconfig
```kconfig
config LIRE_GSL_BUILD_SRC
    bool "    Build GNU Scientific Library"
    default y
    depends on LIRE_BUILD_SRC && LIRE_GSL_INST
    help
    ...
```

## src/hdparm/Kconfig
```kconfig
config LIRE_HDPARM_BUILD_SRC
    bool "    Build hdparm"
    default y
    depends on LIRE_BUILD_SRC && LIRE_HDPARM_INST
    help
    Builds the hdparm package.
```

## src/iproute2/Kconfig
```kconfig
config LIRE_IPROUTE2_BUILD_SRC
    bool "    Build iproute2"
    default y
    depends on LIRE_BUILD_SRC && LIRE_IPROUTE2_INST
    help
    Builds the iproute2 package. This contains mainly the ip command.
```

## src/libdc1394/Kconfig
```kconfig
config LIRE_LIBDC1394_BUILD_SRC
    bool "    Build new libdc1394"
    default y
    depends on LIRE_BUILD_SRC && LIRE_LIBDC1394_INST
    select LIRE_LIBRAW1394_BUILD_SRC
    help
    If the package is too old, you can build a new package from the LIRE-source.
    The LIRE-source have to be linked in the LIRE-SRC directory.
```

## src/libjpeg/Kconfig
```kconfig
config LIRE_LIBJPEG_BUILD_SRC
    bool "    Build new libjpeg"
    default y
    depends on LIRE_LIBJPEG_INST && LIRE_BUILD_SRC
    help
    If the package is too old, you can build a new package from the LIRE-source.
    The LIRE-source have to be linked in the LIRE-SRC directory.
```

## src/libpng/Kconfig
```kconfig
config LIRE_LIBPNG_BUILD_SRC
    bool "    Build new libpng"
    default y
    depends on LIRE_LIBPNG_INST && LIRE_BUILD_SRC
    select LIRE_ZLIB_BUILD_SRC
    help
    If the package is too old, you can build a new package from the LIRE-source.
    The LIRE-source have to be linked in the LIRE-SRC directory.
```

## src/librackrtros/Kconfig
```kconfig
config LIRE_LIBRACKRTROS_BUILD_SRC
    bool "    Build modified RACK library for rtros"
    default n
    depends on LIRE_BUILD_SRC && LIRE_LIBRACKRTROS_INST
    select LIRE_XENOMAI_BUILD_SRC
    select LIRE_RACK_BUILD_SRC
    help
    ...T_T...
```

## src/libraw1394/Kconfig
```kconfig
config LIRE_LIBRAW1394_BUILD_SRC
    bool "    Build new libraw1394"
    default y
    depends on LIRE_BUILD_SRC && LIRE_LIBRAW1394_INST
    help
    If the package is too old, you can build a new package from the LIRE-source.
    The LIRE-source have to be linked in the LIRE-SRC directory.
```

## src/librtros/Kconfig
```kconfig
config LIRE_LIBRTROS_BUILD_SRC
    bool "    Build librtros (Real-Time ROS library)"
    default n
    depends on LIRE_BUILD_SRC && LIRE_LIBRTROS_INST
    select LIRE_XENOMAI_BUILD_SRC
    select LIRE_LIBRACKRTROS_BUILD_SRC
    select LIRE_CATKIN_BUILD_SRC
    select LIRE_ROS_COMM_BUILD_SRC
    help
    ...T_T...
```

## src/libsdl/Kconfig
```kconfig
config LIRE_LIBSDL_BUILD_SRC
    bool "    Build SDL"
    default y
    depends on LIRE_BUILD_SRC && LIRE_LIBSDL_INST
    help
```

## src/libselinux/Kconfig
```kconfig
config LIRE_LIBSELINUX_BUILD_SRC
    bool "    Build new libselinux"
    default n
    depends on LIRE_BUILD_SRC && LIRE_LIBSELINUX_INST
    select LIRE_LIBSEPOL_BUILD_SRC
    help
    ...
```

## src/libsepol/Kconfig
```kconfig
config LIRE_LIBSEPOL_BUILD_SRC
    bool "    Build new libsepol"
    default n
    depends on LIRE_BUILD_SRC && LIRE_LIBSEPOL_INST
    help
    ...
```

## src/libsocketcan/Kconfig
```kconfig
config LIRE_LIBSOCKETCAN_BUILD_SRC
    bool "    Build libsocketcan"
    default y
    depends on LIRE_BUILD_SRC && LIRE_LIBSOCKETCAN_INST
    help
    Builds libsocketcan.
```

## src/libtinyxml/Kconfig
```kconfig
config LIRE_LIBTINYXML_BUILD_SRC
    bool "    Build TinyXML-1 as library"
    default n
    depends on LIRE_BUILD_SRC && LIRE_LIBTINYXML_INST
    help
    ...
```

## src/libusb/Kconfig
```kconfig
config LIRE_LIBUSB_BUILD_SRC
    bool "    Build libusb"
    default y
    depends on LIRE_BUILD_SRC && LIRE_LIBUSB_INST
    help
    build libusb
```

## src/linux/Kconfig
```kconfig
config LIRE_LINUX_BUILD_SRC
    bool "    Build new Linux kernel"
    default y
    depends on LIRE_BUILD_SRC
    help
    If the package is too old, you can build a new linux package from the LIRE-linux source.
    The LIRE-linux source have to be linked in the LIRE-SRC directory.
```

## src/linux_scnd/Kconfig
```kconfig
config LIRE_LINUX_SCND_BUILD_SRC
    bool "    Build new _SECOND_ Linux kernel"
    default y
    depends on LIRE_BUILD_SRC && LIRE_LINUX_SCND_INST
    help
    Here you can build the second linux kernel. You *SHOULD* build it instead of using the "binary".
    Therefore it's the default. Maybe it's better to leave it ALL default.
```

## src/lz4/Kconfig
```kconfig
config LIRE_LZ4_BUILD_SRC
    bool "    Build lz4"
    default n
    depends on LIRE_BUILD_SRC && LIRE_LZ4_INST
    help
    ...
```
