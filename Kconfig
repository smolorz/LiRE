## packages/genlisp/Kconfig
```kconfig
config LIRE_GENLISP_INST
    bool "  Install genlisp"
    default n 
    select LIRE_CATKIN_INST
    select LIRE_GENMSG_INST
    help
    ...text...
```

## packages/genmsg/Kconfig
```kconfig
config LIRE_GENMSG_INST
    bool "  Install genmsg"
    default n 
    select LIRE_CATKIN_INST
    help
    ...text...
```

## packages/genpy/Kconfig
```kconfig
config LIRE_GENPY_INST
    bool "  Install genpy"
    default n 
    select LIRE_CATKIN_INST
    select LIRE_GENMSG_INST
    help
    ...text...
```

## packages/geometry/Kconfig
```kconfig
config LIRE_GEOMETRY_INST
    bool "  Install ROS geometry package"
    default n 
    select LIRE_ROS_COMM_INST
    select LIRE_LZ4_INST
    select LIRE_STD_MSGS_INST
    select LIRE_COMMON_MSGS_INST
    select LIRE_MESSAGE_GENERATION_INST
    select LIRE_PYTHON_INST
    select LIRE_BOOST_INST
    help
    ...text...
```

## packages/gsl/Kconfig
```kconfig
config LIRE_GSL_INST
    bool "  GNU Scientific Library"
    default n
    help
    ...text...
```

## packages/hdparm/Kconfig
```kconfig
config LIRE_HDPARM_INST
    bool "  Install hdparm"
    default y
    help
    Installs hdparm. E.g. it can change kernel opton DMA yes / no during runtime.
```
