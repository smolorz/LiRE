## src/message_generation/Kconfig
```kconfig
config LIRE_MESSAGE_GENERATION_BUILD_SRC
    bool "    Build message_generation"
    default n
    depends on LIRE_BUILD_SRC && LIRE_MESSAGE_GENERATION_INST
    select LIRE_CATKIN_BUILD_SRC
    select LIRE_GENMSG_BUILD_SRC
    select LIRE_GENCPP_BUILD_SRC
    select LIRE_GENLISP_BUILD_SRC
    select LIRE_GENPY_BUILD_SRC
    help
	...
```

## src/message_runtime/Kconfig
```kconfig
config LIRE_MESSAGE_RUNTIME_BUILD_SRC
    bool "    Build message_runtime"
    default n
    depends on LIRE_BUILD_SRC && LIRE_MESSAGE_RUNTIME_INST
    select LIRE_CATKIN_BUILD_SRC
    select LIRE_ROSCPP_CORE_BUILD_SRC
    select LIRE_GENPY_BUILD_SRC
    help
	...
```

## src/nano/Kconfig
```kconfig
config LIRE_NANO_BUILD_SRC
    bool "    Build Nano(pico) Editor"
    default y
    depends on LIRE_BUILD_SRC && LIRE_NANO_INST
    select LIRE_NCURSES_BUILD_SRC
    help
    ...
```

## src/ncurses/Kconfig
```kconfig
config LIRE_NCURSES_BUILD_SRC
    bool "    Build new ncurses library"
    default y
    depends on LIRE_BUILD_SRC && LIRE_NCURSES_INST
    help
    ...
```

## src/netifaces/Kconfig
```kconfig
config LIRE_NETIFACES_BUILD_SRC
    bool "    Build netifaces for target"
    default n
    depends on LIRE_PYTHON_BUILD_SRC && LIRE_NETIFACES_INST
    select LIRE_SETUPTOOLS_BUILD_SRC
    help
    ...
```

## src/opencv/Kconfig
```kconfig
config LIRE_OPENCV_BUILD_SRC
    bool "    Build new OpenCV"
    default y
    depends on LIRE_BUILD_SRC && LIRE_OPENCV_INST
    select LIRE_BOOST_BUILD_SRC
    select LIRE_LIBPNG_BUILD_SRC 
    select LIRE_LIBJPEG_BUILD_SRC
    select LIRE_ZLIB_BUILD_SRC
    help
```

## src/opendds/Kconfig
```kconfig
config LIRE_OPENDDS_BUILD_SRC
    bool "    Build OpenDDS"
    default n
    depends on LIRE_BUILD_SRC && LIRE_OPENDDS_INST
    help
    ...
```

## src/openni/Kconfig
```kconfig
config LIRE_OPENNI_BUILD_SRC
    bool "    Build OpenNI"
    default y
    depends on LIRE_BUILD_SRC && LIRE_OPENNI_INST
    select LIRE_LIBUSB_BUILD_SRC
    help
    ...
```

## src/openssh/Kconfig
```kconfig
config LIRE_OPENSSH_BUILD_SRC
    bool "    Build new OpenSSH"
    default y
    depends on LIRE_BUILD_SRC && LIRE_OPENSSH_INST
    select LIRE_ZLIB_BUILD_SRC
    select LIRE_OPENSSL_BUILD_SRC
    help
    ...
```

## src/openssl/Kconfig
```kconfig
config LIRE_OPENSSL_BUILD_SRC
    bool "    Build new OpenSSL"
    default n
    depends on LIRE_BUILD_SRC && LIRE_OPENSSL_INST
    help
    ...
```

## src/openvpn/Kconfig
```kconfig
config LIRE_OPENVPN_BUILD_SRC
    bool "    Build new OpenVPN"
    default y
    depends on LIRE_BUILD_SRC && LIRE_OPENVPN_INST
    select LIRE_OPENSSL_BUILD_SRC 
    help
    If the package is too old, you can build a new package from the LIRE-source.
    The LIRE-source have to be linked in the LIRE-SRC directory.
```

## src/orocos_bfl/Kconfig
```kconfig
config LIRE_OROCOS_BFL_BUILD_SRC
    bool "    Build orocos-bfl"
    default n
    depends on LIRE_BUILD_SRC && LIRE_OROCOS_BFL_INST
    select LIRE_BOOST_BUILD_SRC
    help
	...
```

## src/parted/Kconfig
```kconfig
config LIRE_PARTED_BUILD_SRC
    bool "    Build parted"
    default y
    depends on LIRE_BUILD_SRC && LIRE_PARTED_INST
    select LIRE_E2FSPROGS_BUILD_SRC
    help
    Build the parted package.
```

## src/pciutils/Kconfig
```kconfig
config LIRE_PCIUTILS_BUILD_SRC
    bool "    Build pciutils"
    default y
    depends on LIRE_BUILD_SRC && LIRE_PCIUTILS_INST
    help
    Builds the pciutils, beeing able to use lspci and so on.
```

## src/pcl/Kconfig
```kconfig
config LIRE_PCL_BUILD_SRC
    bool "    Build new pcl"
    default n
    depends on LIRE_BUILD_SRC && LIRE_PCL_INST
    select LIRE_FLANN_BUILD_SRC
    select LIRE_EIGEN_BUILD_SRC
    select LIRE_BOOST_BUILD_SRC
    help
    ...

source src/pcl/Kconfig.compile_options
```

## src/pcl/Kconfig.compile_options
```kconfig
menu "Pcl compile options"
    depends on LIRE_PCL_BUILD_SRC
config LIRE_PCL_HAS_SSE
    bool "    SSE"
    default y
    help
    ...
config LIRE_PCL_HAS_SSE2
    bool "    SSE2"
    default y
    help
    ...
config LIRE_PCL_HAS_SSE3
    bool "    SSE3"
    default y
    help
    ...
config LIRE_PCL_HAS_SSE4_1
    bool "    SSE4_1"
    default n
    help
    ...

endmenu
```

## src/policy/Kconfig
```kconfig
config LIRE_POLICY_BUILD_SRC
    bool "    Build new policy"
    depends on LIRE_BUILD_SRC && LIRE_POLICY_INST
    help
    ...

config LIRE_POLICY_BUILD_AUDIT
    bool "    Enable full auditing"
    depends on LIRE_POLICY_BUILD_SRC
    help
    ...
```

## src/policycoreutils/Kconfig
```kconfig
config LIRE_POLICYCOREUTILS_BUILD_SRC
    bool "    Build new policycoreutils"
    depends on LIRE_BUILD_SRC && LIRE_POLICYCOREUTILS_INST
    select LIRE_LIBSELINUX_BUILD_SRC
    help
    ...
```

## src/primesense/Kconfig
```kconfig
config LIRE_PRIMESENSE_BUILD_SRC
    bool "    Build PrimeSense driver library"
    default y
    depends on LIRE_BUILD_SRC && LIRE_PRIMESENSE_INST
    select LIRE_OPENNI_BUILD_SRC
    help
    ...
```

## src/python/Kconfig
```kconfig
config LIRE_PYTHON_BUILD_SRC
    bool "    Build new python"
    default n
    depends on LIRE_BUILD_SRC && LIRE_PYTHON_INST
    select LIRE_NCURSES_BUILD_SRC
    select LIRE_ZLIB_BUILD_SRC
    help
    ...
```

## src/pyyaml/Kconfig
```kconfig
config LIRE_PYYAML_BUILD_SRC
    bool "    Build PyYAML for target"
    default n
    depends on LIRE_PYTHON_BUILD_SRC
    help
    ...
```

## src/rack/Kconfig
```kconfig
config LIRE_RACK_BUILD_SRC
    bool "    Build Rack"
    default y
    depends on LIRE_BUILD_SRC && LIRE_RACK_INST
    select LIRE_XENOMAI_BUILD_SRC
    select LIRE_OPENCV_BUILD_SRC if LIRE_RACK_OPENCV_SUPPORT
    select LIRE_LIBRAW1394_BUILD_SRC if LIRE_RACK_OPENCV_SUPPORT
    select LIRE_LIBDC1394_BUILD_SRC if LIRE_RACK_OPENCV_SUPPORT
    select LIRE_LIBPNG_BUILD_SRC if LIRE_RACK_OPENCV_SUPPORT
    select LIRE_LIBJPEG_BUILD_SRC if LIRE_RACK_OPENCV_SUPPORT
    select LIRE_RTNET_BUILD_SRC if LIRE_RACK_RTNET_SUPPORT
    select LIRE_GSL_BUILD_SRC if LIRE_RACK_GSL_SUPPORT
    select LIRE_ZLIB_BUILD_SRC if LIRE_RACK_ZLIB_SUPPORT
    select LIRE_LIBUSB_BUILD_SRC if LIRE_RACK_LIBUSB_SUPPORT
    select LIRE_BOOST_BUILD_SRC if LIRE_RACK_BOOST_SUPPORT
    select LIRE_PCL_BUILD_SRC if LIRE_RACK_PCL_SUPPORT
    help
```

## src/rack_rts/Kconfig
```kconfig
config LIRE_RACK_RTS_BUILD_SRC
    bool "    Build Rack (RTS private module)"
    default y
    depends on LIRE_BUILD_SRC && LIRE_RACK_RTS_INST
    select LIRE_RACK_BUILD_SRC
    help
```

## src/rack_scnd/Kconfig
```kconfig
config LIRE_RACK_SCND_BUILD_SRC
    bool "    Build Rack kernel misc for scnd kernel"
    default y
    depends on LIRE_BUILD_SRC && LIRE_RACK_SCND_INST
    select LIRE_XENOMAI_SCND_BUILD_SRC
    help
    ...T_T...
```

## src/rackcore/Kconfig
```kconfig
config LIRE_RACKCORE_BUILD_SRC
    bool "    Build RACK core"
    default n
    depends on LIRE_BUILD_SRC && LIRE_RACKCORE_INST
    select LIRE_XENOMAI_SCND_BUILD_SRC
    select LIRE_OPENCV_BUILD_SRC if LIRE_RACKCORE_OPENCV_SUPPORT
    select LIRE_LIBPNG_BUILD_SRC if LIRE_RACKCORE_LIBPNG_SUPPORT
    select LIRE_LIBJPEG_BUILD_SRC if LIRE_RACKCORE_LIBJPEG_SUPPORT
    select LIRE_ZLIB_BUILD_SRC if LIRE_RACKCORE_ZLIB_SUPPORT
    select LIRE_LIBUSB_BUILD_SRC if LIRE_RACKCORE_LIBUSB_SUPPORT
    select LIRE_BOOST_BUILD_SRC if LIRE_RACKCORE_BOOST_SUPPORT
    select LIRE_PCL_BUILD_SRC if LIRE_RACKCORE_PCL_SUPPORT
    help
    Build RACK core components (TiMS and librack). Xenomai 3 required.
```
