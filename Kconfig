## Kconfig
```kconfig
config LIRE_VERSION
    string "LiRE-Version"
    default "CHANGE ME"

source "packages/Kconfig"
source "src/Kconfig"

menu "Image"

config LIRE_OUTDIR
    string "LIRE output directory"
    default "/YOUR/PATH/LiRE-0.9-betaX/targetfs"
    help
    Absolute path to a LIRE-install directory (e.g. /tmp/LIRE-install).

choice
    prompt "Image type"
    default LIRE_DISK


config LIRE_DISK
    bool "Disk"
    help

config LIRE_NETBOOT
    bool "Netboot"
    help

config LIRE_QEMU
    bool "QEMU"
    help

config LIRE_ISO
    bool "ISO (CD-ROM)"
    help

config LIRE_VIRTUALBOX
    bool "Virtualbox"
    help

endchoice

config LIRE_BUILD_REMOTELY
    bool "Use build_server for parts that need root-privileges"
    default y
    help
    ...

config LIRE_INSTALL_HOST
    depends on LIRE_BUILD_REMOTELY
    string "Hostname of the install server"
    default localhost
    help
    ...
    
config LIRE_INSTALL_PORT
    depends on LIRE_BUILD_REMOTELY
    int "Portnumber of the install server"
    default 56000
    help
    ...

config LIRE_HOST_SYSLINUX_DIR
    string "Host syslinux directory"
    default "/usr/lib/syslinux"
    help
    The directory in which isolinux.bin and menu.c32 can be found.

config LIRE_IMGNAME
    string "Image name"
    default "spb.nb" if LIRE_NETBOOT
    default "lireQE.img" if LIRE_QEMU
    default "lire.iso" if LIRE_ISO
    depends on LIRE_NETBOOT || LIRE_QEMU || LIRE_ISO
    help

config LIRE_IMGSIZE
    int "Image size"
    default 100000
    depends on LIRE_NETBOOT || LIRE_QEMU || LIRE_ISO || LIRE_VIRTUALBOX
    help

config LIRE_DATA_IMGSIZE
    int "Image size data partition [0: disable]"
    default 0
    depends on LIRE_QEMU || LIRE_VIRTUALBOX
    help

config LIRE_BOOTOPTIONS
    string "Boot parameters"
    default "vga=773"
    depends on LIRE_NETBOOT || LIRE_ISO
    help

config LIRE_ISO_CUSTOM_DIR
    string "ISO Custom directory"
    default ""
    depends on LIRE_ISO
    help
    The content from this directory will be copied into the iso image

config LIRE_KEEP_IMGS
    bool "Keep intermediate images"
    depends on LIRE_NETBOOT
    help

endmenu

menu "Target debugging"

config LIRE_GDB_INST
    bool "  Install GDB (Debugger)"
    depends on LIRE_CROSS_COMPILE
    default n
    help
    ...text...

config LIRE_GDB_SERVER_ONLY
    bool "  Install only gdbserver"
    depends on LIRE_GDB_INST
    default y
    help
    The gdb binary is quite large and restricted to console operation.
    In contrast, the small gdbserver can be used remotely with any
    gdb-backend, graphical ones included.

config LIRE_STRACE_INST
    bool "  Install strace"
    depends on LIRE_CROSS_COMPILE
    default y
    help
    ...text...

endmenu

source "base/Kconfig"
```

## base/Kconfig
```kconfig
menu "Target configuration"

config LIRE_TARGET_HOSTNAME
    string "Target Host name"
    default "SPB_GENERIC"
    help
    ...text...

config LIRE_TARGET_INIT_ETHERNET
    bool "Init Ethernet network"
    default y
    help
    ...text...

config LIRE_TARGET_ETHERNET_NIC
    string "Ethernet NIC used in boot scripts"
    default "eth0"
    help
    The ethernet NIC (network interface connector) device (e.g. eth0) which shall be used in the scripts during boot to initialize the ethernet network.

config LIRE_TARGET_MAIN_IP
    string "IP address for the SPB"
    default "DHCP"
    depends on LIRE_TARGET_INIT_ETHERNET || LIRE_TARGET_INIT_WLAN
    help
    Use 'DHCP' or a valid IP address

config LIRE_TARGET_ETH_DRIVERS
    string "List of Ethernet drivers to load" if !LIRE_QEMU
    default "e100 8139too 3c59x r8169 e1000 via-rhine pcnet32 e1000e igb tg3 mcs7830 asix" if !LIRE_QEMU
    default "ne2k-pci e1000" if LIRE_QEMU
    depends on LIRE_TARGET_INIT_ETHERNET
    help
    The following modules are supported by the default kernel:
    3c501, 3c503, 3c505, 3c507, 3c509, 3c59x, 8139cp, 8139too, 8390, e100,
    eepro, eepro100, eexpress, hp100, ne, ne2k-pci, pcnet32, smc-ultra,
    smc9194, tg3, via-rhine, wd.
    NOTE: These modules will only be loaded if TARGET_INIT_ETHERNET is set!

config LIRE_TARGET_INIT_WLAN
    bool "Init WLAN network"
    help
    Choose y here, if you want to use "native" wlan (e.g. wlan usb stick) on your SPB

config LIRE_TARGET_WLAN_NIC
    string "WLAN NIC used in boot scripts"
    default "wlan0"
    help
    The WLAN NIC (network interface connector) device (e.g. wlan0) which shall be used in the scripts during boot to initialize the wlan network.

config LIRE_TARGET_WLAN_IP
    string "wlan IP adress for the SPB"
    default "DHCP"
    help
    Use 'DHCP' or a valid IP adress

config LIRE_TARGET_WLAN_SSID
    string "WLAN SSID"
    default ""
    help
    Specifies the WLAN SSID which shall be used by TARGET_WLAN_NIC if TARGET_INIT_WLAN is set.

config LIRE_TARGET_INIT_WPA_SUPPLICANT
    bool "Start wpa_supplicant on boot"
    default n
    help
    This starts the wpa_supplicant on boot using the /etc/wpa_supplicant.conf configuration file on the target (e.g. you have to modify this file according to your needs). Wpa_supplicant will use the interface specified by LIRE_TARGET_WLAN_NIC.

config LIRE_TARGET_INIT_WLANPOLL
    bool "Start wlanpolling on boot"
    help
    wlanpoll realizes roaming between wireless access points with all have one ESSID. If the link quality of the current access point falls below a threshold value all APs with the same ESSID are scanned. The AP with the best link quality is then chosen as the new one.

config LIRE_TARGET_WLANPOLL_OPTS
    string "wlanpoll options"
    default ""
    help
    wlanpoll supports the following options. The values in ( ) are the defaults.
    -i wireless network interface that should be polled ("wlan0")
    -p polling period in seconds (5)
    -t link quality threshold in percent (50)
    -w threshold width, value is driver dependent (1)
    -e ESSID of the APs
    -v 1: verbose output (0)

config LIRE_TARGET_WLAN_DRIVERS
    string "List of WLAN drivers to load" if !LIRE_QEMU
    default "at76c50x-usb rtl8187 iwl3945 rt2800usb" if !LIRE_QEMU
    default "" if LIRE_QEMU
    help
    The following modules are supported by the default kernel:
    from staging (our default): at76_usb (for the atmel wlan usb stick)
    from in-kernel (broken at the moment): at76c50x-usb (for the atmel wlan usb stick)
    NOTE: These modules will only be loaded if TARGET_INIT_WLAN is set!

config LIRE_TARGET_OPENVPN_AUTOSTART
    bool "Openvpn Autostart"
    help
    Choose y here, if you want openvpn to start on boot.

config LIRE_TARGET_OPENVPN_PROFILE
    string "Openvpn profile"
    default "default"
    help
    The Openvpn profile to use for all options needed to be known to Openvpn to make it work correctly. Available profiles are located under '/etc/openvpn/profiles/'. You can easily create your own profile, or modify available ones. Just have a look into a profile. If you do not need Openvpn or want to see (or even adjust) an example profile to make it work for your needs, leave it 'default'.

config LIRE_TARGET_KEYMAP
    string "Keymap"
    default "DE"
    help
    ...text...

config LIRE_TARGET_RUN_spb_pack_manager
    bool "Run package boot manager"
    default y

config LIRE_TARGET_LAUNCH_HTTPD
    bool "Run HTTP server"
    default y

config LIRE_TARGET_LAUNCH_SYSLOGD
    bool "Run system log daemon"
    default y

config LIRE_TARGET_SYSLOGCONSOLE
    int "Console for dumping kernel messages"
    default 10

config LIRE_SETPASSWD
    bool "Set target root password"
    default n
    help
    If this option is not set the target root password will be empty.

config LIRE_PASSWD
    string "Password"
    default ""
    depends on LIRE_SETPASSWD
    help
    Set the root password of the image to this password. If this string 
    is empty, you will be queried for the password during installation.
    
config LIRE_TARGET_TMPFS_SUPPORT
    bool "Support for tmpfs"
    default y

config LIRE_TARGET_TMPFS_DIRS
    string "TMPFS dirs"
    default "/var/log;/var/lock;/var/run;/var/db;/var/lib/ni;/tmp"

config LIRE_TARGET_REMOUNT_ROOT_RW
    bool "Mount root directory read/write"

config LIRE_TARGET_NR_READY_BEEPS
    int "No of beeps if ready"
    default 1

config LIRE_TARGET_NR_HALT_BEEPS
    int "No of beeps if halt"
    default 2

config LIRE_TARGET_DEV_ON_TMPFS
    bool "Remount /dev on tmpfs"
    default n
    help
    Leave this option off if your kernel supports devtmpfs.

config LIRE_TARGET_USB_SUPPORT
    bool "USB support"
    default y

config LIRE_TARGET_OPENNI_DEVICE
    string "OpenNI camera device (xtion, kinect or none)"
    default "none"

config LIRE_TARGET_OPENNI_CONFIGDIR
    string "OpenNI directory for config files"
    default "/tmp"

endmenu
```

## packages/Kconfig
```kconfig
menu "Packages"

source  "packages/xenomai/Kconfig"

comment "*SECOND* Kernel Options"
source  "packages/linux_scnd/Kconfig"
source  "packages/xenomai_scnd/Kconfig"
source  "packages/rtnet_scnd/Kconfig"
#source  "packages/rack_scnd/Kconfig"

comment "Applications"
source      "packages/opencv/Kconfig"
source      "packages/openvpn/Kconfig"
source 	    "packages/openssl/Kconfig"
source 	    "packages/openssh/Kconfig"
source      "packages/nano/Kconfig"
source      "packages/pciutils/Kconfig"
source      "packages/hdparm/Kconfig"
source      "packages/e2fsprogs/Kconfig"
source      "packages/parted/Kconfig"
source      "packages/iproute2/Kconfig"
source      "packages/setserial/Kconfig"
source      "packages/dhcpcd/Kconfig"
source      "packages/tinyxml2/Kconfig"
source      "packages/curl/Kconfig"
source      "packages/opendds/Kconfig"
source      "packages/ssdp_responder/Kconfig"

comment "Python"
source      "packages/python/Kconfig"
source      "packages/empy/Kconfig"
source      "packages/setuptools/Kconfig"
source      "packages/pyyaml/Kconfig"
source      "packages/netifaces/Kconfig"

comment "WLAN"
source      "packages/wireless_tools/Kconfig"
source      "packages/wlanpoll/Kconfig"
source      "packages/wpa_supplicant/Kconfig"

comment "Real-Time Drivers"
source      "packages/rtnet/Kconfig"

comment "Misc Drivers"

comment "RACK"
source      "packages/rackcore/Kconfig"
#source      "packages/rack_rts/Kconfig"
source      "packages/librackrtros/Kconfig"

comment ""
menuconfig ROS
	bool "ROS"
	default n
	---help---
	  Say Y here to see options for installing the Robot Operating
	  System.

if ROS

source      "packages/catkin_pkg/Kconfig"
source      "packages/catkin/Kconfig"
source      "packages/rospkg/Kconfig"
source      "packages/cmake_modules/Kconfig"
source      "packages/rospack/Kconfig"
source	    "packages/roscpp_core/Kconfig"
source      "packages/ros_core/Kconfig"
source      "packages/genmsg/Kconfig"
source      "packages/gencpp/Kconfig"
source      "packages/genpy/Kconfig"
source      "packages/genlisp/Kconfig"
source      "packages/message_generation/Kconfig"
source      "packages/message_runtime/Kconfig"
source      "packages/std_msgs/Kconfig"
source      "packages/ros_comm_msgs/Kconfig"
source      "packages/ros_comm/Kconfig"
source      "packages/common_msgs/Kconfig"
source      "packages/librtros/Kconfig"
source      "packages/geometry/Kconfig"
source      "packages/orocos_bfl/Kconfig"

endif

comment ""
menu "Libraries"
comment "Libraries"
source      "packages/libdc1394/Kconfig"
source      "packages/libjpeg/Kconfig"
source      "packages/libpng/Kconfig"
source      "packages/libraw1394/Kconfig"
source      "packages/ncurses/Kconfig"
source      "packages/zlib/Kconfig"
source      "packages/gsl/Kconfig"
source      "packages/libusb/Kconfig"
source      "packages/expat/Kconfig"
source      "packages/boost/Kconfig"
source      "packages/bzip2/Kconfig"
source      "packages/eigen/Kconfig"
source      "packages/flann/Kconfig"
source      "packages/pcl/Kconfig"
source      "packages/libsocketcan/Kconfig"
source      "packages/openni/Kconfig"
source      "packages/primesense/Kconfig"
source      "packages/sensorkinect/Kconfig"
source      "packages/console_bridge/Kconfig"
source      "packages/lz4/Kconfig"
source      "packages/libtinyxml/Kconfig"
source      "packages/libsdl/Kconfig"
source      "packages/sdl_image/Kconfig"
source      "packages/yaml_cpp/Kconfig"

endmenu

comment ""

config LIRE_UPDATE_DIR
    string "LIRE update directory"
    default ""
    help
    Absolute url/path to a directory/ftp with the LiRE-update (binary and  source) 
    directory structure

config LIRE_SCP_UPDATE_SERVER
    string "LiRE scp update server"
    default ""
    help
    Scp server for non-public packages.

config LIRE_CUSTOMDIR_ENABLE
    bool "Enable copy of a custom directory"

config LIRE_CUSTOMDIR
    string "LIRE custom directory"
    default "/home/`whoami`/LIRE-custom"
    depends on LIRE_CUSTOMDIR_ENABLE
    help
    Absolute path to a directory with all custom install scripts and
    config files (e.g. /home/`whoami`/LIRE-custom).
    The script lire_custom_start have to be in the directory and will be
    started by lire autostart.

endmenu
```

## packages/boost/Kconfig
```kconfig
config LIRE_BOOST_INST
    bool "  Install Boost libraries"
    default y
    select LIRE_EXPAT_INST
    select LIRE_BZIP2_INST
    help
    ...text...
```

## packages/bzip2/Kconfig
```kconfig
config LIRE_BZIP2_INST
    bool "  Install bzip2"
    default y
    help
    ...text...
```

## packages/catkin/Kconfig
```kconfig
config LIRE_CATKIN_INST
    bool "  Install Catkin"
    default n 
    select LIRE_PYTHON_INST
    select LIRE_EMPY_INST
    select LIRE_CATKIN_PKG_INST
    help
    ...text...
```

## packages/catkin_pkg/Kconfig
```kconfig
config LIRE_CATKIN_PGK_INST
    bool "  Install standalone Python scripts for Catkin"
    default n 
    depends on LIRE_PYTHON_INST
    help
    ...text...
```

## packages/cmake_modules/Kconfig
```kconfig
config LIRE_CMAKE_MODULES_INST
    bool "  Install cmake_modules"
    default n 
    select LIRE_CATKIN_INST
    select LIRE_LIBTINYXML_INST
    help
    ...text...
```

## packages/common_msgs/Kconfig
```kconfig
config LIRE_COMMON_MSGS_INST
    bool "  Install common_msgs"
    default n 
    select LIRE_CATKIN_INST
    select LIRE_MESSAGE_GENERATION_INST
    select LIRE_MESSAGE_RUNTIME_INST
    select LIRE_STD_MSGS_INST
    select LIRE_ROSCPP_CORE_INST
    select LIRE_BOOST_INST
    help
    ...text...
```

## packages/console_bridge/Kconfig
```kconfig
config LIRE_CONSOLE_BRIDGE_INST
    bool "  Install console-bridge"
    default n 
    select LIRE_BOOST_INST
    help
    ...text...
```

## packages/curl/Kconfig
```kconfig
config LIRE_CURL_INST
    bool "  Install Curl"
    default n
    select LIRE_OPENSSL_INST
    select LIRE_ZLIB_INST
    help
    curl is a command line tool and library for transferring data with URL syntax 
```

## packages/dhcpcd/Kconfig
```kconfig
config LIRE_DHCPCD_INST
    bool "  Install dhcpcd"
    default y
    help
    ...text...
```

## packages/e2fsprogs/Kconfig
```kconfig
config LIRE_E2FSPROGS_INST
    bool "  Install e2fsprogs"
    default y
    help
    Installs e2fsprogs utilities for ext2..4 filesystems. Such as e2fsck.
```

## packages/eigen/Kconfig
```kconfig
config LIRE_EIGEN_INST
    bool "  Install eigen"
    default n
    help
    ...text...
```

## packages/empy/Kconfig
```kconfig
config LIRE_EMPY_INST
    bool "  Install EmPy"
    default n 
    depends on LIRE_PYTHON_INST
    help
    ...text...
```

## packages/expat/Kconfig
```kconfig
config LIRE_EXPAT_INST
    bool "  Install Expat XML Parser"
    default y
    help
    ...text...
```

## packages/flann/Kconfig
```kconfig
config LIRE_FLANN_INST
    bool "  Install flann"
    default y
    help
    ...text...
```

## packages/gencpp/Kconfig
```kconfig
config LIRE_GENCPP_INST
    bool "  Install gencpp"
    default n 
    select LIRE_CATKIN_INST
    select LIRE_GENMSG_INST
    help
    ...text...
```
