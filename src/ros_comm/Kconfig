## src/ros_comm/Kconfig
```kconfig
config LIRE_ROS_COMM_BUILD_SRC
    bool "    Build ros_comm"
    default n
    depends on LIRE_BUILD_SRC && LIRE_ROS_COMM_INST
    select LIRE_ROSCPP_CORE_BUILD_SRC
    select LIRE_ROS_CORE_BUILD_SRC
    select LIRE_LZ4_BUILD_SRC
    select LIRE_BOOST_BUILD_SRC
    select LIRE_CONSOLE_BRIDGE_BUILD_SRC
    select LIRE_ROS_CORE_BUILD_SRC
    select LIRE_BZIP2_BUILD_SRC
    select LIRE_STD_MSGS_BUILD_SRC
    select LIRE_GENCPP_BUILD_SRC
    select LIRE_GENMSG_BUILD_SRC
    select LIRE_GENPY_BUILD_SRC
    select LIRE_GENLISP_BUILD_SRC
    select LIRE_MESSAGE_RUNTIME_BUILD_SRC
    select LIRE_MESSAGE_GENERATION_BUILD_SRC
    select LIRE_ROS_COMM_MSGS_BUILD_SRC
    select LIRE_PYTHON_BUILD_SRC
    select LIRE_PYYAML_BUILD_SRC
    select LIRE_ROSPKG_BUILD_SRC
    help
	...
```

## src/ros_comm_msgs/Kconfig
```kconfig
config LIRE_ROS_COMM_MSGS_BUILD_SRC
    bool "    Build ros_comm_msgs"
    default n
    depends on LIRE_BUILD_SRC && LIRE_ROS_COMM_MSGS_INST
    select LIRE_STD_MSGS_BUILD_SRC
    select LIRE_MESSAGE_GENERATION_BUILD_SRC
    select LIRE_MESSAGE_RUNTIME_BUILD_SRC
    select LIRE_ROSCPP_CORE_BUILD_SRC
    help
	...
```

## src/ros_core/Kconfig
```kconfig
config LIRE_ROS_CORE_BUILD_SRC
    bool "    Build ROS core packages"
    default n
    depends on LIRE_BUILD_SRC && LIRE_ROS_CORE_INST
    select LIRE_CATKIN_BUILD_SRC
    select LIRE_ROSPACK_BUILD_SRC
    select LIRE_BOOST_BUILD_SRC
    help
	...
```

## src/roscpp_core/Kconfig
```kconfig
config LIRE_ROSCPP_CORE_BUILD_SRC
    bool "    Build roscpp_core"
    default n
    depends on LIRE_BUILD_SRC && LIRE_ROSCPP_CORE_INST
    select LIRE_CATKIN_BUILD_SRC
    select LIRE_BOOST_BUILD_SRC
    help
    ...
```

## src/rospack/Kconfig
```kconfig
config LIRE_ROSPACK_BUILD_SRC
    bool "    Build rospack"
    default n
    depends on LIRE_BUILD_SRC && LIRE_ROSPACK_INST
    select LIRE_CATKIN_BUILD_SRC
    select LIRE_BOOST_BUILD_SRC
    select LIRE_CMAKE_MODULES_BUILD_SRC
    select LIRE_LIBTINYXML_BUILD_SRC
    select LIRE_PYTHON_BUILD_SRC
    help
	...
```

## src/rospkg/Kconfig
```kconfig
config LIRE_ROSPKG_BUILD_SRC
    bool "    Build rospkg for target"
    default n
    depends on LIRE_BUILD_SRC && LIRE_ROSPKG_INST
    select LIRE_PYTHON_BUILD_SRC
    select LIRE_SETUPTOOLS_BUILD_SRC
    select LIRE_PYYAML_BUILD_SRC
    help
    ...
```

## src/rtnet/Kconfig
```kconfig
config LIRE_RTNET_BUILD_SRC
    bool "    Build new RTnet"
    default y
    depends on LIRE_BUILD_SRC && LIRE_RTNET_INST
    select LIRE_XENOMAI_BUILD_SRC
    help
    If the package is too old, you can build a new package from the LIRE-source.
    The LIRE-source have to be linked in the LIRE-SRC directory.
```

## src/rtnet_scnd/Kconfig
```kconfig
config LIRE_RTNET_SCND_BUILD_SRC
    bool "   RTnet kernel stuff for scnd kernel"
    default y
    depends on LIRE_BUILD_SRC && LIRE_RTNET_SCND_INST
    select LIRE_XENOMAI_SCND_BUILD_SRC
    help
    Build kernel stuff from rtnet for the second kernel.
```

## src/sdl_image/Kconfig
```kconfig
config LIRE_SDL_IMAGE_BUILD_SRC
    bool "    Build SDL-Image library"
    default y
    depends on LIRE_BUILD_SRC && LIRE_SDL_IMAGE_INST
    select LIRE_LIBPNG_BUILD_SRC 
    select LIRE_LIBJPEG_BUILD_SRC
    select LIRE_LIBSDL_BUILD_SRC
    select LIRE_ZLIB_BUILD_SRC
    help
```

## src/sensorkinect/Kconfig
```kconfig
config LIRE_SENSORKINECT_BUILD_SRC
    bool "    Build Kinect driver library (OpenNI based, by avin2)"
    default y
    depends on LIRE_BUILD_SRC && LIRE_SENSORKINECT_INST
    select LIRE_OPENNI_BUILD_SRC
    help
    ...
```

## src/setserial/Kconfig
```kconfig
config LIRE_SETSERIAL_BUILD_SRC
    bool "    Build new setserial"
    default y
    depends on LIRE_BUILD_SRC && LIRE_SETSERIAL_INST
    help
    ...
```

## src/setuptools/Kconfig
```kconfig
config LIRE_SETUPTOOLS_BUILD_SRC
    bool "    Include setuptools in HostPython"
    default n
    depends on LIRE_PYTHON_BUILD_SRC
    help
    ...
```

## src/ssdp_responder/Kconfig
```kconfig
config LIRE_SSDP_RESPONDER_BUILD_SRC
    bool "    Build ssdp-responder"
    default n
    depends on LIRE_BUILD_SRC && LIRE_SSDP_RESPONDER_INST
    help
    Build the ssdp-responder daemon.
```

## src/std_msgs/Kconfig
```kconfig
config LIRE_STD_MSGS_BUILD_SRC
    bool "    Build std_msgs"
    default n
    depends on LIRE_BUILD_SRC && LIRE_STD_MSGS_INST
    select LIRE_CATKIN_BUILD_SRC
    select LIRE_GENMSG_BUILD_SRC
    select LIRE_GENCPP_BUILD_SRC
    select LIRE_GENLISP_BUILD_SRC
    select LIRE_GENPY_BUILD_SRC
    select LIRE_MESSAGE_GENERATION_BUILD_SRC
    help
	...
```

## src/tinyxml2/Kconfig
```kconfig
config LIRE_TINYXML2_BUILD_SRC
    bool "    Build TinyXML-2"
    default n
    depends on LIRE_BUILD_SRC && LIRE_TINYXML2_INST
    help
    ...
```

## src/wireless_tools/Kconfig
```kconfig
config LIRE_WIRELESS_TOOLS_BUILD_SRC
    bool "    Build Wireless Tools"
    default y
    depends on LIRE_BUILD_SRC && LIRE_WIRELESS_TOOLS_INST
    help
    Build wireless-tools.
```

## src/wlanpoll/Kconfig
```kconfig
config LIRE_WLANPOLL_BUILD_SRC
    bool "    Build Wlanpoll"
    default y
    depends on LIRE_BUILD_SRC && LIRE_WLANPOLL_INST
    help
    Build wlanpoll from source
```

## src/wpa_supplicant/Kconfig
```kconfig
config LIRE_WPA_SUPPLICANT_BUILD_SRC
    bool "    Build wpa_supplicant"
    default y
    depends on LIRE_BUILD_SRC && LIRE_WPA_SUPPLICANT_INST
    select LIRE_OPENSSL_BUILD_SRC
    help
    Builds wpa_supplicant
```

## src/xenomai/Kconfig
```kconfig
config LIRE_XENOMAI_BUILD_SRC
    bool "    Build new xenomai"
    default y
    depends on LIRE_BUILD_SRC && LIRE_XENOMAI_INST
    select LIRE_LINUX_BUILD_SRC
    help
    If the package is too old, you can build a new package from the LIRE-source.
    The LIRE-source have to be linked in the LIRE-SRC directory.
```

## src/xenomai_scnd/Kconfig
```kconfig
config LIRE_XENOMAI_SCND_BUILD_SRC
    bool "    Build new _SECOND_ xenomai"
    default y
    depends on LIRE_BUILD_SRC && LIRE_XENOMAI_SCND_INST
    select LIRE_LINUX_SCND_BUILD_SRC
    help
    This is the package that provides a xenomai patch for a *SECOND* linux kernel.
```

## src/yaml_cpp/Kconfig
```kconfig
config LIRE_YAML_CPP_BUILD_SRC
    bool "    Build yaml-cpp"
    default n
    depends on LIRE_BUILD_SRC && LIRE_YAML_CPP_INST
    select LIRE_BOOST_BUILD_SRC
    help
	...
```

## src/zlib/Kconfig
```kconfig
config LIRE_ZLIB_BUILD_SRC
    bool "    Build new zlib"
    default y
    depends on LIRE_BUILD_SRC && LIRE_ZLIB_INST
    help
    ...
```
